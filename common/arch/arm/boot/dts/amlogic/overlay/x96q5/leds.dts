/dts-v1/;
/plugin/;

/ {
	fragment@0 {
		target = <&gpioleds>;

		__overlay__ {
			/delete-node/  net_red;
			/delete-node/  net_green;
			/delete-node/  remote_led;
			/delete-node/  sys_led;
		};
	};
};
